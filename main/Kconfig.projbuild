## main/Kconfig.projbuild
```kconfig
menu "USB Serial Configuration"

    choice USB_SERIAL_DRIVER
        prompt "USB Serial Driver Type"
        default USB_SERIAL_DRIVER_AUTO
        help
            Select the USB serial driver type to use.

        config USB_SERIAL_DRIVER_CDC
            bool "CDC-ACM Driver"
            help
                Use USB CDC-ACM driver for serial communication.

        config USB_SERIAL_DRIVER_FTDI
            bool "FTDI Driver"
            select USB_HOST_ENABLE_FTDI_SIO_DRIVER
            help
                Use FTDI driver for serial communication.

        config USB_SERIAL_DRIVER_AUTO
            bool "Auto-Detect (Both Drivers)"
            select USB_HOST_ENABLE_FTDI_SIO_DRIVER
            help
                Automatically detect and use the appropriate driver
                based on USB device VID/PID. Both CDC-ACM and FTDI
                drivers will be installed and the application will
                automatically switch between them at runtime.
    endchoice

endmenu

menu "TCP Server Configuration"

    config TCP_SERVER_PORT
        int "TCP Data Port"
        range 1 65535
        default 8888
        help
            Port number for the TCP data server.

    config TCP_CONTROL_PORT
        int "TCP Control Port"
        range 1 65535
        default 8889
        help
            Port number for the TCP control server.
            Used for serial port control (DTR/RTS, baudrate).

    config TCP_RX_BUFFER_SIZE
        int "TCP RX Buffer Size"
        range 128 2048
        default 512
        help
            Size of the TCP receive buffer in bytes.

    config DATA_BUFFER_POOL_SIZE
        int "Data Buffer Pool Size"
        range 4 64
        default 64
        help
            Number of data buffers in the static buffer pool.

endmenu

menu "RFC2217 Configuration"

    config RFC2217_ENABLE
        bool "Enable RFC2217 Server"
        default y
        help
            Enable RFC2217 (Telnet COM Port Control) server for
            remote serial port access. Compatible with pyserial
            rfc2217:// URL handler.

    config RFC2217_PORT
        int "RFC2217 Server Port"
        depends on RFC2217_ENABLE
        range 1 65535
        default 2217
        help
            Port number for the RFC2217 server.
            Standard port is 2217. pyserial defaults to this port.

    config RFC2217_MODEM_POLL_INTERVAL_MS
        int "Modem Status Poll Interval (ms)"
        depends on RFC2217_ENABLE
        range 50 1000
        default 100
        help
            Interval for polling modem status (CTS/DSR/RI/CD).
            Lower values provide faster response but use more CPU.
            Note: Only FTDI devices support modem status reading.

endmenu

menu "Serial Control Configuration"

    config SERIAL_CTRL_RETRY_INTERVAL_MS
        int "Retry Interval (ms)"
        range 1 100
        default 10
        help
            Interval between retries when serial control operations
            return ESP_ERR_NOT_FINISHED (device busy).

    config SERIAL_CTRL_RETRY_COUNT
        int "Retry Count"
        range 1 50
        default 10
        help
            Number of retries when serial control operations
            return ESP_ERR_NOT_FINISHED. Total retry time is
            approximately RETRY_INTERVAL_MS * RETRY_COUNT.

endmenu

menu "Network Provisioning Configuration"

    choice PROV_SECURITY_VERSION
        prompt "Provisioning Security Version"
        default PROV_SECURITY_VERSION_1
        help
            Network provisioning supports security versions 0, 1, and 2.

        config PROV_SECURITY_VERSION_0
            bool "Security Version 0 (Plain text - Testing only)"

        config PROV_SECURITY_VERSION_1
            bool "Security Version 1 (Proof of Possession)"

        config PROV_SECURITY_VERSION_2
            bool "Security Version 2 (SRP6a)"
    endchoice

    config PROV_POP_CODE
        string "Proof of Possession Code"
        depends on PROV_SECURITY_VERSION_1
        default "abcd1234"
        help
            PoP (Proof of Possession) code for Security Version 1.
            This code must be entered during provisioning to authenticate.

    config WIFI_MAXIMUM_RETRY
        int "WiFi connection maximum retry"
        default 5
        help
            Set the maximum retry count for WiFi connection attempts.

endmenu

menu "OTA Update Configuration"

    config OTA_HTTP_SERVER_PORT
        int "HTTP Server Port"
        range 1 65535
        default 80
        help
            Port number for the HTTP server used for OTA firmware updates.
            Default is 80 for standard HTTP access.

    config OTA_MAX_UPLOAD_SIZE
        int "Maximum Firmware Size (bytes)"
        range 524288 983040
        default 983040
        help
            Maximum firmware size in bytes (960 KB default).
            This prevents uploading firmware larger than the OTA partition.
            Must not exceed the size of ota_0/ota_1 partitions (0xF0000 = 983040 bytes).

    config OTA_ENABLE_ROLLBACK
        bool "Enable Automatic Rollback"
        default y
        help
            Enable automatic rollback to previous firmware if new firmware
            fails to boot or crashes. The bootloader will automatically
            revert to the previous working firmware version.

endmenu
```
